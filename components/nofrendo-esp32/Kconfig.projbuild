## components/nofrendo-esp32/Kconfig.projbuild
```kconfig
menu "Nofrendo ESP32-specific configuration"

choice HW_LCD_TYPE_SEL
	prompt "LCD type"

config HW_LCD_TYPE_ILI
	bool "ILI9341 LCD"

config HW_LCD_TYPE_ST
	bool "ST7789V LCD"

endchoice

config HW_LCD_TYPE
	int
	default 0 if HW_LCD_TYPE_ILI
	default 1 if HW_LCD_TYPE_ST


config HW_LCD_BL_GPIO
	int "LCD Backlight Enable pin"
	range 1 35
	default 13

config HW_LCD_CLK_GPIO
	int "LCD CLK pin"
	range 1 35
	default 33

config HW_LCD_MOSI_GPIO
	int "LCD MOSI pin"
	range 1 35
	default 25

config HW_LCD_DC_GPIO
	int "LCD DC pin"
	range 1 35
	default 27

config HW_LCD_RESET_GPIO
	int "LCD RESET pin"
	range 1 35
	default 14

config HW_LCD_CS_GPIO
	int "LCD CS pin"
	range 1 35
	default 12

config HW_INV_BL
	bool "Invert backlight output"
	default n


config SOUND_ENA
	bool "Analog audio on GPIO26"
	default n
	help
		ESP32 will output 0-3.3V analog audio signal on GPIO26.


config GAMEPAD_A
	int "Gamepad A GPIO pin number"
	range 0 33
	default 16

config GAMEPAD_B
	int "Gamepad B GPIO pin number"
	range 0 33
	default 5

config GAMEPAD_START
	int "Gamepad START GPIO pin number"
	range 0 33
	default 23

config GAMEPAD_SELECT
	int "Gamepad SELECT GPIO pin number"
	range 0 33
	default 19

config GAMEPAD_UP
	int "Gamepad UP GPIO pin number"
	range 0 33
	default 0

config GAMEPAD_DOWN
	int "Gamepad DOWN GPIO pin number"
	range 0 33
	default 4

config GAMEPAD_LEFT
	int "Gamepad LEFT GPIO pin number"
	range 0 33
	default 2

config GAMEPAD_RIGHT
	int "Gamepad RIGHT GPIO pin number"
	range 0 33
	default 22

endmenu
```
